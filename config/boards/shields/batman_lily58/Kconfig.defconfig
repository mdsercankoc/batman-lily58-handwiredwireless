## config/boards/shields/batman_lily58/Kconfig.defconfig
```kconfig
if SHIELD_BATMAN_LILY58_LEFT || SHIELD_BATMAN_LILY58_RIGHT

config ZMK_KEYBOARD_NAME
    default "Batman Lily58"

endif
```

## config/boards/shields/batman_lily58/Kconfig.shield
```kconfig
config SHIELD_BATMAN_LILY58_LEFT
    def_bool $(shields_list_contains,batman_lily58_left)

config SHIELD_BATMAN_LILY58_RIGHT
    def_bool $(shields_list_contains,batman_lily58_right)
```
